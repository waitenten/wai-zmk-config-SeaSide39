## config/boards/shields/SeaSide39/Kconfig.defconfig
```kconfig
if SHIELD_SeaSide39_R

config ZMK_KEYBOARD_NAME
    default "SeaSide39_R"

config ZMK_SPLIT
    default y
endif

if SHIELD_SeaSide39_L

config ZMK_KEYBOARD_NAME
    default "SeaSide39_L"

config ZMK_SPLIT
    default y

endif
```

## config/west.yml
```yaml
manifest:
  remotes:
    - name: zmkfirmware
      url-base: https://github.com/zmkfirmware
    - name: badjeff
      url-base: https://github.com/badjeff
    - name: caksoylar
      url-base: https://github.com/caksoylar
    - name: kot149
      url-base: https://github.com/kot149
    - name: ssbb
      url-base: https://github.com/ssbb
    - name: zettaface
      url-base: https://github.com/zettaface
  projects:
    - name: zmk
      remote: zmkfirmware
      revision: v0.3
      import: app/west.yml
    - name: zmk-pmw3610-driver
      remote: badjeff
      revision: main
    - name: zmk-rgbled-widget
      remote: caksoylar
      revision: v0.3
    - name: zmk-mouse-gesture
      remote: kot149
      revision: v1
    - name: zmk-listeners
      remote: ssbb
      revision: v1
    - name: zmk-input-processor-keybind
      remote: zettaface
      revision: main
  self:
    path: config
```

## modules/custom_battery_typist/Kconfig
```kconfig
config CUSTOM_BATTERY_TYPIST
    bool "Enable battery level typing behavior"
    default y
    depends on ZMK_SPLIT_BLE_CENTRAL_BATTERY_LEVEL_FETCHING
    depends on ZMK_SPLIT_ROLE_CENTRAL
```
